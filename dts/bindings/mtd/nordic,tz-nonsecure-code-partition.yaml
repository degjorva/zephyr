## dts/bindings/mtd/nordic,tz-nonsecure-code-partition.yaml
```yaml
# Copyright (c) 2026 Nordic Semiconductor ASA
# SPDX-License-Identifier: Apache-2.0

description: |
  Nordic TrustZone Non-Secure Code Partition.

  Marks a flash/RRAM partition as an image slot for Non-Secure code on Nordic
  TrustZone-capable SoCs (nRF91, nRF53, nRF54L, ...). Consumed by the TF-M
  build to compute FLASH_NS_PARTITION_SIZE (the per-slot size fed to the
  non-secure image maximum size).

  This binding is a peer of "nordic,tz-nonsecure-data-partition", not a
  specialization of an umbrella tag. Code slots carry only this compatible;
  data regions (NS storage, ...) carry only the data-partition compatible.
  The TF-M build aggregates both compatibles when it needs the total
  non-secure flash footprint (FLASH_NONSECURE_TOTAL_SIZE).

  Any number of okay nodes of this compatible is allowed, but they must all
  have the same reg size (primary and secondary MCUboot slots must match).
  A BUILD_ASSERT in the TF-M build enforces this.

  Example (single slot, non-MCUboot):

      slot0_ns_partition: partition@8a000 {
          compatible = "nordic,tz-nonsecure-code-partition";
          label = "image-0-nonsecure";
          reg = <0x0008a000 DT_SIZE_K(940)>;
      };

compatible: "nordic,tz-nonsecure-code-partition"

include: [base.yaml]

properties:
  reg:
    required: true
  label:
    type: string
    required: false
```

## dts/bindings/mtd/nordic,tz-nonsecure-data-partition.yaml
```yaml
# Copyright (c) 2026 Nordic Semiconductor ASA
# SPDX-License-Identifier: Apache-2.0

description: |
  Nordic TrustZone Non-Secure Data Partition.

  Marks a flash/RRAM partition as assigned to the ARM TrustZone Non-Secure
  state and carrying *data* (not executable code) on Nordic TrustZone-capable
  SoCs (nRF91, nRF53, nRF54L, ...). Typical consumers are non-secure storage
  backends (ZMS, settings, etc.).

  This binding is a peer of "nordic,tz-nonsecure-code-partition", not an
  umbrella over it. Code slots use the code-partition compatible exclusively;
  data regions use this one. The TF-M build aggregates both compatibles to
  compute the full non-secure flash footprint (FLASH_NONSECURE_TOTAL_SIZE);
  doing the split at the binding level lets FLASH_NS_PARTITION_SIZE remain a
  per-slot value without needing extra tagging on each node.

  The tag is additive: the node is still a child of a "fixed-partitions"
  table and continues to be validated by the fixed-partitions child-binding.

  Example:

      &cpuapp_rram {
          partitions {
              compatible = "fixed-partitions";
              #address-cells = <1>;
              #size-cells = <1>;

              storage_partition: partition@175000 {
                  compatible = "nordic,tz-nonsecure-data-partition";
                  label = "storage";
                  reg = <0x00175000 DT_SIZE_K(32)>;
              };
          };
      };

compatible: "nordic,tz-nonsecure-data-partition"

include: [base.yaml]

properties:
  reg:
    required: true
  label:
    type: string
    required: false
```

## dts/bindings/mtd/nordic,tz-secure-code-partition.yaml
```yaml
# Copyright (c) 2026 Nordic Semiconductor ASA
# SPDX-License-Identifier: Apache-2.0

description: |
  Nordic TrustZone Secure Code Partition.

  Marks a flash/RRAM partition as an image slot for Secure code on Nordic
  TrustZone-capable SoCs (nRF91, nRF53, nRF54L, ...), e.g. the TF-M secure
  image slot. Consumed by the TF-M build to compute FLASH_S_PARTITION_SIZE
  (the per-slot size fed to SECURE_IMAGE_MAX_SIZE).

  This binding is a peer of "nordic,tz-secure-data-partition", not a
  specialization of an umbrella tag. Code slots carry only this compatible;
  data regions (PS, ITS, OTP, ...) carry only the data-partition compatible.
  The TF-M build aggregates both compatibles when it needs the total secure
  flash footprint (FLASH_SECURE_TOTAL_SIZE).

  Any number of okay nodes of this compatible is allowed, but they must all
  have the same reg size (primary and secondary MCUboot slots must match).
  A BUILD_ASSERT in the TF-M build enforces this.

  Example (single slot, non-MCUboot):

      slot0_partition: partition@0 {
          compatible = "nordic,tz-secure-code-partition";
          label = "image-0";
          reg = <0x0 DT_SIZE_K(512)>;
      };

compatible: "nordic,tz-secure-code-partition"

include: [base.yaml]

properties:
  reg:
    required: true
  label:
    type: string
    required: false
```

## dts/bindings/mtd/nordic,tz-secure-data-partition.yaml
```yaml
# Copyright (c) 2026 Nordic Semiconductor ASA
# SPDX-License-Identifier: Apache-2.0

description: |
  Nordic TrustZone Secure Data Partition.

  Marks a flash/RRAM partition as assigned to the ARM TrustZone Secure state
  and carrying *data* (not executable code) on Nordic TrustZone-capable SoCs
  (nRF91, nRF53, nRF54L, ...). Typical consumers are the TF-M Protected
  Storage (PS), Internal Trusted Storage (ITS) and OTP / NV-counter areas.

  This binding is a peer of "nordic,tz-secure-code-partition", not an umbrella
  over it. Code slots use the code-partition compatible exclusively; data
  regions use this one. The TF-M build aggregates both compatibles to compute
  the full secure flash footprint (FLASH_SECURE_TOTAL_SIZE); doing the split
  at the binding level lets FLASH_S_PARTITION_SIZE remain a per-slot value
  without needing extra tagging on each node.

  The tag is additive: the node is still a child of a "fixed-partitions"
  table and continues to be validated by the fixed-partitions child-binding.

  Example:

      &cpuapp_rram {
          partitions {
              compatible = "fixed-partitions";
              #address-cells = <1>;
              #size-cells = <1>;

              tfm_ps_partition: partition@80000 {
                  compatible = "nordic,tz-secure-data-partition";
                  label = "tfm-ps";
                  reg = <0x00080000 DT_SIZE_K(16)>;
              };
          };
      };

compatible: "nordic,tz-secure-data-partition"

include: [base.yaml]

properties:
  reg:
    required: true
  label:
    type: string
    required: false
```
